## CMakeLists.txt
```
# Elemental's tests as one Zephyr application, run by Twister
# (docs/build.md, "Tests on Zephyr").
#
# Elemental is added as a subproject with its tests on. Every test a module
# registers with elemental_add_test() is compiled into this image
# (cmake/ElementalTestImage.cmake), so a new module's tests are included
# without a change here.

cmake_minimum_required(VERSION 3.20.0)
# boards/: nucleo_g0b1re_renode, the ARMv6-M board the tests run on.
list(APPEND BOARD_ROOT "${CMAKE_CURRENT_SOURCE_DIR}")

# A wire for the tests that need bytes to arrive on a UART, ring_zephyr_uart's
# and examples/uart_ring's: QEMU connects the board's second and third UART
# to the two ends of one socket, so that what the image sends on UART1
# arrives on UART2. The console stays on the first. The path is relative, to
# QEMU's working directory, which is the build directory. For mps2/an385,
# with CONFIG_UART_INTERRUPT_DRIVEN (testcase.yaml, elemental.tests.ring.uart).
# Set before Zephyr's package is found, which reads QEMU_EXTRA_FLAGS.
option(ELEMENTAL_ZEPHYR_UART_WIRE "Join UART1 and UART2 under QEMU, and build the tests that use the wire" OFF)
if(ELEMENTAL_ZEPHYR_UART_WIRE)
  list(APPEND QEMU_EXTRA_FLAGS
    -chardev socket,id=wire0,path=uart-wire.sock,server=on,wait=off -serial chardev:wire0
    -chardev socket,id=wire1,path=uart-wire.sock -serial chardev:wire1)
endif()

find_package(Zephyr REQUIRED HINTS $ENV{ZEPHYR_BASE})
project(elemental_tests LANGUAGES C CXX)

# Off for a board too small for GoogleTest: the libraries are still built
# for it and their symbols checked (testcase.yaml, elemental.symbols.*).
option(ELEMENTAL_ZEPHYR_TESTS "Compile Elemental's tests into the image" ON)

get_filename_component(ELEMENTAL_ROOT "${CMAKE_CURRENT_SOURCE_DIR}/../.." ABSOLUTE)
if(ELEMENTAL_ZEPHYR_TESTS)
  target_sources(app PRIVATE src/main.cpp)
  if(NOT CONFIG_ARCH_POSIX)
    target_sources(app PRIVATE src/libc_support.c)
  endif()
  set(ELEMENTAL_BUILD_TESTS ON)
  set(ELEMENTAL_BUILD_EXAMPLES ON)
  set(ELEMENTAL_TEST_IMAGE app)

  # One image per module. GoogleTest's registry and per-test records take
  # heap for each test, so one module's tests per image keeps each image
  # within the smallest board's RAM as modules grow. testcase.yaml has one
  # scenario per module (elemental.tests.<module>); "all" builds every test
  # into one image, which the configuration scenarios use. Each module lists
  # its tests' elemental_add_test() name prefixes, an example with the
  # module it tests; a test in no module stops the configure. A new module
  # adds itself here and its scenario in testcase.yaml.
  set(ELEMENTAL_TEST_MODULES status alloc io ring fmt bytes crc time log)
  set(ELEMENTAL_TEST_MODULE_status status)
  set(ELEMENTAL_TEST_MODULE_alloc alloc example.size_classes)
  set(ELEMENTAL_TEST_MODULE_io io io_zephyr_uart)
  set(ELEMENTAL_TEST_MODULE_ring ring ring_zephyr_uart example.uart_ring)
  set(ELEMENTAL_TEST_MODULE_fmt fmt)
  set(ELEMENTAL_TEST_MODULE_bytes bytes)
  set(ELEMENTAL_TEST_MODULE_crc crc)
  set(ELEMENTAL_TEST_MODULE_time time time_zephyr example.step_clock)
  set(ELEMENTAL_TEST_MODULE_log log example.tee_sink)
  set(ELEMENTAL_TEST_MODULE "all" CACHE STRING
      "The module whose tests this image holds: all, or one of ${ELEMENTAL_TEST_MODULES}")
  if(NOT ELEMENTAL_TEST_MODULE STREQUAL "all" AND NOT ELEMENTAL_TEST_MODULE IN_LIST ELEMENTAL_TEST_MODULES)
    message(FATAL_ERROR "ELEMENTAL_TEST_MODULE: '${ELEMENTAL_TEST_MODULE}' is not all or one of ${ELEMENTAL_TEST_MODULES}")
  endif()
else()
  target_sources(app PRIVATE src/no_tests.c)
endif()
# A variant: one of the repository's configs/<name>_defconfig, applied on
# top of this image's own elemental_defconfig, so the image runs the same
# configurations as the host presets (testcase.yaml).
set(ELEMENTAL_ZEPHYR_VARIANT "" CACHE STRING
    "Name of a configs/<name>_defconfig to apply on top of elemental_defconfig")
set(defconfig "${CMAKE_CURRENT_SOURCE_DIR}/elemental_defconfig")
if(ELEMENTAL_ZEPHYR_VARIANT)
  set(variant "${ELEMENTAL_ROOT}/configs/${ELEMENTAL_ZEPHYR_VARIANT}_defconfig")
  if(NOT EXISTS "${variant}")
    message(FATAL_ERROR "ELEMENTAL_ZEPHYR_VARIANT: ${variant} does not exist")
  endif()
  file(READ "${defconfig}" base_text)
  file(READ "${variant}" variant_text)
  set(defconfig "${CMAKE_CURRENT_BINARY_DIR}/elemental_${ELEMENTAL_ZEPHYR_VARIANT}_defconfig")
  file(WRITE "${defconfig}" "${base_text}${variant_text}")
endif()
set(ELEMENTAL_DEFCONFIG "${defconfig}" CACHE FILEPATH
    "Kconfig fragment that seeds Elemental's configuration in this image")
# Elemental's own sources with its strict warnings, as errors, under the
# board's compiler. (Zephyr's flags come later on the command line and set
# -std=c17; that the sources are C11 is checked by the host presets.)
set(ELEMENTAL_WARNINGS_AS_ERRORS ON)
add_subdirectory("${ELEMENTAL_ROOT}" elemental)

# Zephyr keeps the flags that describe the board (CPU, ABI, C library) in
# zephyr_interface rather than in global flags. Every library Elemental's
# build defines, GoogleTest included, is compiled with them.
function(elemental_use_board_flags directory)
  get_property(targets DIRECTORY "${directory}" PROPERTY BUILDSYSTEM_TARGETS)
  foreach(target IN LISTS targets)
    get_target_property(type ${target} TYPE)
    if(type STREQUAL "STATIC_LIBRARY")
      target_link_libraries(${target} PRIVATE zephyr_interface)
    endif()
  endforeach()
  get_property(subdirectories DIRECTORY "${directory}" PROPERTY SUBDIRECTORIES)
  foreach(subdirectory IN LISTS subdirectories)
    elemental_use_board_flags("${subdirectory}")
  endforeach()
endfunction()
elemental_use_board_flags("${ELEMENTAL_ROOT}")

# The symbol check: what Elemental's libraries need from outside themselves,
# compiled for this Cortex-M board by its toolchain. Anything not in
# allowed-undefined.txt fails the build. A symbol only one configuration
# needs goes in allowed-undefined.<SYMBOL>.txt, which is read only when
# Elemental's EL_CONFIG_<SYMBOL> is set.
if(CONFIG_ARM)
  get_property(modules GLOBAL PROPERTY ELEMENTAL_MODULES)
  set(archives "")
  foreach(module IN LISTS modules)
    list(APPEND archives "$<TARGET_FILE:elemental_${module}>")
  endforeach()
  set(allow --allow "${CMAKE_CURRENT_SOURCE_DIR}/allowed-undefined.txt")
  file(GLOB conditional_lists "${CMAKE_CURRENT_SOURCE_DIR}/allowed-undefined.*.txt")
  foreach(list IN LISTS conditional_lists)
    string(REGEX REPLACE ".*/allowed-undefined\\.(.*)\\.txt$" "\\1" symbol "${list}")
    get_directory_property(enabled DIRECTORY "${ELEMENTAL_ROOT}" DEFINITION EL_CONFIG_${symbol})
    if(enabled)
      list(APPEND allow --allow "${list}")
    endif()
  endforeach()
  add_custom_target(elemental_symbols ALL
    COMMAND "${PYTHON_EXECUTABLE}" "${ELEMENTAL_ROOT}/tools/check_symbols.py"
            --nm "${CMAKE_NM}" ${allow}
            ${archives}
    COMMENT "Checking the symbols Elemental's libraries leave undefined"
    VERBATIM)
  list(TRANSFORM modules PREPEND elemental_)
  add_dependencies(elemental_symbols ${modules})
endif()
```

## prj.conf
```kconfig
# GoogleTest needs a hosted C++17 library: libstdc++ from the toolchain.
CONFIG_CPP=y
CONFIG_STD_CPP17=y
CONFIG_REQUIRES_FULL_LIBCPP=y

# The tests run on the main thread. A contract test's harness keeps its
# buffers on the stack, and the default 1 KiB stack overflowed into other
# memory without a fault. The image prints how much it used (src/main.cpp);
# the size leaves room over that.
CONFIG_MAIN_STACK_SIZE=4096
CONFIG_INIT_STACKS=y
CONFIG_THREAD_STACK_INFO=y
CONFIG_STACK_SENTINEL=y
CONFIG_SYS_HEAP_RUNTIME_STATS=y
```

## boards/native_sim.conf
```kconfig
# native_sim's UARTs (zephyr,native-pty-uart) can be interrupt-driven, so
# the UART backends (io_zephyr_uart, ring_zephyr_uart) and their tests
# against a scripted device build and run here too. The first UART is the
# console now, and stays on the process's stdin and stdout, which Twister
# reads.
CONFIG_SERIAL=y
CONFIG_UART_INTERRUPT_DRIVEN=y
CONFIG_UART_NATIVE_PTY_0_ON_STDINOUT=y
```

## boards/st/nucleo_g0b1re_renode/nucleo_g0b1re_renode.dts
```dts
/*
 * The stock nucleo_g0b1re devicetree, with one change: the 48 MHz clock
 * for USB is off. The Renode model's clock controller is written for an
 * STM32G071, which has no HSI48, and never reports it ready, so a boot that
 * enables it waits forever. Elemental's tests use no USB.
 */
#include "nucleo_g0b1re.dts"

&clk_hsi48 {
	status = "disabled";
};
```

## src/main.cpp
```c
/*
 * The entry point of the Zephyr test image. Every Elemental test registered
 * with elemental_add_test() is compiled into this image; GoogleTest runs
 * them all and prints the report Twister's gtest harness reads.
 */
#include <gtest/gtest.h>
#include <zephyr/kernel.h>
#include <zephyr/sys/sys_heap.h>

#include <cstdio>

namespace
{

/*
 * Twister's gtest harness (Zephyr v4.5.0) knows a test ended from "[ OK ]",
 * "[ FAILED ]", or "[ DISABLED ]", but not from GoogleTest's "[ SKIPPED ]",
 * and fails the run when a test it saw start never ends. A contract test
 * skips when a fixture lacks a capability, so a skip is reported again in
 * the form the harness counts as skipped.
 */
class ReportSkipsToTwister : public testing::EmptyTestEventListener
{
    void OnTestEnd(const testing::TestInfo &test) override
    {
        if (test.result()->Skipped()) {
            std::printf("[ DISABLED ] %s.%s\n", test.test_suite_name(), test.name());
        }
    }
};

} // namespace

/* Zephyr's malloc (lib/libc/common), with CONFIG_SYS_HEAP_RUNTIME_STATS. */
extern "C" int malloc_runtime_stats_get(struct sys_memory_stats *stats);

int main(void)
{
    char program[] = "elemental_tests";
    char *argv[] = {program, nullptr};
    int argc = 1;
    testing::InitGoogleTest(&argc, argv);
    testing::UnitTest::GetInstance()->listeners().Append(new ReportSkipsToTwister);
    const int result = RUN_ALL_TESTS();

#ifndef CONFIG_ARCH_POSIX
    /*
     * The memory the run needed, recorded in docs/build.md: the peak heap
     * (GoogleTest allocates its registry and messages) and the stack, which
     * CONFIG_MAIN_STACK_SIZE must cover. Not meaningful on native_sim, whose
     * threads run on the host's stacks.
     */
    struct sys_memory_stats heap;
    if (malloc_runtime_stats_get(&heap) == 0) {
        std::printf("heap: %zu bytes at most\n", heap.max_allocated_bytes);
    }
    size_t unused = 0;
    if (k_thread_stack_space_get(k_current_get(), &unused) == 0) {
        std::printf("main stack: %zu of %d bytes used\n",
                    static_cast<size_t>(CONFIG_MAIN_STACK_SIZE) - unused, CONFIG_MAIN_STACK_SIZE);
    }
#endif
    return result;
}
```

## src/libc_support.c
```c
/*
 * Two functions GoogleTest and libstdc++ call that picolibc on a Zephyr
 * Cortex-M board does not provide. native_sim does not need them.
 */
#include <zephyr/kernel.h>

#include <errno.h>
#include <sys/time.h>
#include <unistd.h>

/* Whether to print in colour. The console is not a terminal. */
int isatty(int fd)
{
    (void)fd;
    errno = ENOTTY;
    return 0;
}

/*
 * GoogleTest times each test with std::chrono::system_clock, which libstdc++
 * reads with gettimeofday(). Time since boot is enough for that. Zephyr's
 * own gettimeofday() (CONFIG_XSI_SINGLE_PROCESS) needs a hardware info
 * driver these boards do not have.
 */
int gettimeofday(struct timeval *tv, void *tz)
{
    (void)tz;
    int64_t ms = k_uptime_get();
    tv->tv_sec = (time_t)(ms / 1000);
    tv->tv_usec = (suseconds_t)((ms % 1000) * 1000);
    return 0;
}
```

## src/no_tests.c
```c
/*
 * The image when ELEMENTAL_ZEPHYR_TESTS is off: Elemental's libraries are
 * built for the board and their symbols checked, and nothing runs.
 */
int main(void)
{
    return 0;
}
```
