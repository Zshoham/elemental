## modules/alloc/Kconfig
```kconfig
config ALLOC
	bool "alloc: allocator interface and arenas"
	default y
	select STATUS
	help
	  The el_allocator interface, a bump arena and a stack arena over
	  caller-provided storage, and the contract test suite for
	  allocators. Freestanding: needs no runtime symbol.

config ALLOC_LIBC
	bool "alloc_libc: allocator over the C library heap"
	default y
	depends on ALLOC && PLATFORM_POSIX
	help
	  An el_allocator over malloc(), aligned_alloc(), and free(), for
	  programs with a hosted C library. Available where the POSIX probe
	  finds <unistd.h>, which stands in for "a hosted C library": Linux
	  is the only host operating system Elemental supports.
```

## modules/bytes/Kconfig
```kconfig
config BYTES
	bool "bytes: fixed-width integers in a stated byte order"
	default y
	select STATUS
	help
	  Load and store 16-, 32-, and 64-bit values, little and big endian,
	  at any alignment. Freestanding: needs no runtime symbols.
```

## modules/crc/Kconfig
```kconfig
config CRC
	bool "crc: CRC-32 and CRC-16/IBM-3740"
	default y
	select STATUS
	help
	  CRC-32/ISO-HDLC and CRC-16/IBM-3740, computed incrementally over
	  caller memory. Freestanding: needs no runtime symbols, except
	  Zephyr's own CRC functions under CRC_ZEPHYR.

choice CRC_IMPLEMENTATION
	prompt "CRC implementation"
	default CRC_TABLE_4BIT
	depends on CRC
	help
	  What computes the CRCs: Elemental's own tables, or the compiler's
	  or the platform's code. Results are identical with every option,
	  and nothing a caller sees changes.

config CRC_TABLE_4BIT
	bool "16-entry tables (smaller)"
	help
	  Two table lookups per byte; 96 bytes of tables for both CRCs. The
	  right choice unless CRC throughput is measured to matter.

config CRC_TABLE_8BIT
	bool "256-entry tables (faster)"
	help
	  One table lookup per byte; 1.5 KiB of tables for both CRCs. For a
	  high-rate link on a target with flash to spare. Pigweed measured
	  the 256-entry CRC-32 at about 1.4 times the speed of the 16-entry
	  one on a Cortex-M4 (pw_checksum documentation).

config CRC_GCC_BUILTIN
	bool "GCC's CRC builtins"
	depends on COMPILER_GCC_CRC_BUILTINS
	help
	  __builtin_rev_crc32_data8 and __builtin_crc16_data8, from GCC 15.
	  For a target where GCC lowers them to a CRC instruction, which then
	  needs no source change. On x86-64, GCC 16 compiles them to a 1.5 KB
	  table, even with -mpclmul, so there they only cost size.

config CRC_ZEPHYR
	bool "Zephyr's CRC functions"
	depends on PLATFORM_ZEPHYR_CRC
	help
	  crc32_ieee_update() and crc16_itu_t() from <zephyr/sys/crc.h>, for a
	  Zephyr application that already links them, so the code is not
	  there twice. Needs CONFIG_CRC=y in the application, and is not
	  available with CONFIG_CRC_HW_HANDLER, whose driver calls can fail.

endchoice
```

## modules/fmt/Kconfig
```kconfig
config FMT
	bool "fmt: integer conversions, and printf into io buffers"
	default y
	select STATUS
	select IO
	help
	  Integers to decimal and hex text in a caller's scratch array, and
	  a printf subset that formats into an io buffer (el_buf) or a
	  buffered writer, keeping a number whole or absent. No floating
	  point. Freestanding: needs only memcpy().

choice FMT_PRINTF
	prompt "fmt: what printf accepts"
	default FMT_PRINTF_BUILTIN
	depends on FMT
	help
	  The portable subset of printf (elemental/fmt_printf.h) is built-in
	  code under either option, with identical output. The C library
	  option also accepts the rest of C's numeric conversions, one at a
	  time through snprintf(). A format correct under it is a contract
	  violation under the built-in option
	  (docs/adr/0016-private-choices-that-widen.md). Code that must build
	  against any configuration uses the portable subset only.

config FMT_PRINTF_BUILTIN
	bool "Built-in: the portable subset"
	help
	  d i u x X c s % with the 0 flag, decimal widths, a precision on
	  %s, and the length modifiers <inttypes.h> needs. No C library
	  beyond memcpy(), and interrupt-safe into a fixed buffer. The
	  right choice unless the image needs floats, %p or printf's other
	  flags through Elemental's truncation rule.

config FMT_PRINTF_LIBC
	bool "The C library's snprintf() for everything else"
	depends on PLATFORM_SNPRINTF
	help
	  Also accepts every other specification of d i u x X o f F e E g G
	  a A p (flags, precision, '*', j t L), formatted one conversion at
	  a time by snprintf() and entered whole or not at all, and %s and
	  %c with '-' or a '*' width. Floats are whatever the C library
	  writes. For an image that links the C library's printf anyway, or
	  needs floats or %p. Formats in the portable subset still never
	  reach snprintf(). Needs snprintf() from the C library.

endchoice
```

## modules/io/Kconfig
```kconfig
config IO
	bool "io: byte stream reader and writer interfaces"
	default y
	select STATUS
	help
	  The el_reader and el_writer interfaces, helpers built on them, a
	  reader over caller-provided memory, the el_buf memory buffer and
	  the writer that ends in one, a buffered writer, and the contract
	  test suite for backends. Freestanding: needs only memcpy() and
	  memmove().

config IO_POSIX
	bool "io_posix: POSIX file descriptor backend"
	default y
	depends on IO && PLATFORM_POSIX
	help
	  Reader and writer over a file descriptor the caller owns, using
	  read(2) and write(2). Available only when the toolchain provides
	  <unistd.h>.

config IO_ALLOC
	bool "io_alloc: buffer storage that grows, over an allocator"
	default y
	depends on IO && ALLOC
	help
	  el_grow_buf: an el_buf whose storage comes from an el_allocator
	  and grows as needed, for a message or a burst of unknown size. It
	  is the one part of io that needs alloc: turn it off and io builds
	  and links no allocator. Freestanding: needs memcpy().

config IO_ZEPHYR_UART
	bool "io_zephyr_uart: a Zephyr UART as a writer"
	default y
	depends on IO && PLATFORM_ZEPHYR_UART
	help
	  el_zephyr_uart_poll, a writer that passes each byte to
	  uart_poll_out(). Available in a Zephyr build whose configuration
	  has CONFIG_SERIAL; interrupt-driven mode is not needed. Receiving
	  on a UART is ring's RING_ZEPHYR_UART.
```

## modules/io_alloc/Kconfig
```kconfig
config IO_ALLOC
	bool "io_alloc: a writer that grows, over an allocator"
	default y
	depends on IO && ALLOC
	help
	  el_grow_writer: an el_writer that collects what is written in
	  memory from an el_allocator, growing as needed. A separate library
	  so that io never depends on alloc. Freestanding: needs memcpy().
```

## modules/log/Kconfig
```kconfig
config LOG
	bool "log: loggers, log sinks, and printf-style call sites"
	default y
	select STATUS
	select IO
	select FMT
	select TIME
	help
	  Logging for applications: a logger with a level, a tag, and a clock;
	  the el_log_sink interface that decides where records go; a sink
	  that writes text lines to an el_writer, and one that keeps records
	  in caller-provided memory; and the contract test suite for sinks.
	  Elemental's own modules never log.

config LOG_DEFERRED
	bool "log_deferred: a sink that hands records to another context"
	default y
	depends on LOG && RING
	help
	  el_log_deferred_sink: a sink that copies each record into an
	  el_ring and returns, for an interrupt handler or any code that must
	  not wait for where its records are written; another context drains
	  the ring into the sink that writes. It is the one part of log that
	  needs ring: turn it off and log builds and links no ring.
	  Freestanding: needs memcpy().
```

## modules/ring/Kconfig
```kconfig
config RING
	bool "ring: a byte FIFO between two contexts"
	default y
	depends on COMPILER_ATOMICS
	select STATUS
	select IO
	help
	  el_ring: a first-in, first-out buffer of bytes over caller-provided
	  storage, filled by one context while another empties it, with no
	  lock: an interrupt handler and a thread, or two threads. Its two
	  sides are also an el_writer and an el_reader. Freestanding: needs
	  only memcpy(). Needs a compiler that turns a load and a store of an
	  atomic word into instructions (docs/adr/0023); CMake probes that
	  the two compile.

config RING_ZEPHYR_UART
	bool "ring_zephyr_uart: a Zephyr UART's receive interrupt filling a ring"
	default y
	depends on RING && PLATFORM_ZEPHYR_UART_IRQ
	help
	  el_zephyr_uart_irq: a UART's receive interrupt writes what arrives
	  into a ring the caller set up, counts what did not fit, and calls
	  the application when bytes arrive, so that a thread can wait for
	  them and read them through the ring's reader. For a sensor or a
	  modem on a UART whose bytes must not be lost while the thread is
	  busy. Available in a Zephyr build whose configuration has
	  CONFIG_SERIAL and CONFIG_UART_INTERRUPT_DRIVEN.
```

## modules/status/Kconfig
```kconfig
config STATUS
	bool "status: status codes and contract assertions"
	default y
	help
	  The vocabulary every other module shares: the el_status codes
	  returned for recoverable failures, and the EL_ASSERT() check used
	  for contract violations.

if STATUS

config ASSERT
	bool "Check contract assertions"
	default y
	help
	  Compile EL_ASSERT() checks into Elemental's modules. They catch
	  programmer mistakes at the interface: null pointers, misuse of an
	  object, and backends that break their contract.

	  With this off, the checks compile to nothing and violating a
	  documented precondition is undefined behavior. Turn it off only for
	  an image that has been validated with it on and cannot afford the
	  code size; the cost on a Cortex-M3 build is recorded in
	  docs/build.md.

choice ASSERT_HANDLER
	prompt "Assertion failure handler"
	default ASSERT_HANDLER_TRAP
	depends on ASSERT
	help
	  What a failed EL_ASSERT() does.

config ASSERT_HANDLER_TRAP
	bool "Trap at the failing check"
	help
	  Execute a trap instruction where the check failed. This needs no
	  runtime support and stores no strings: a debugger or fault handler
	  sees the exact location. The right default for firmware and for
	  hosted development alike.

config ASSERT_HANDLER_APPLICATION
	bool "Call el_assert_failed(), defined by the application"
	help
	  Call el_assert_failed(file, line), which the application must
	  define and which must not return. Use this to route failures into
	  a product's fault handling, or to report where a check failed.
	  Linking fails if the function is missing.

	  Each check then carries a file name and line number, which costs
	  read-only data.

endchoice

endif # STATUS
```

## modules/time/Kconfig
```kconfig
config TIME
	bool "time: clock interface, tick conversions, and a manual clock"
	default y
	select STATUS
	help
	  The el_clock interface: a monotonic reading in the clock's own
	  ticks, and how many of them make a second. Conversion between
	  ticks and milliseconds or seconds, a clock the caller advances for
	  tests, and the contract test suite for clocks. Freestanding: needs
	  no runtime symbol, and no compiler helper for its 64-bit
	  arithmetic.

config TIME_POSIX
	bool "time_posix: the system's monotonic clock"
	default y
	depends on TIME && PLATFORM_POSIX
	help
	  An el_clock over clock_gettime(CLOCK_MONOTONIC), in nanoseconds.
	  Available where the POSIX probe finds <unistd.h>.

config TIME_ZEPHYR
	bool "time_zephyr: the Zephyr kernel's uptime"
	default y
	depends on TIME && PLATFORM_ZEPHYR
	help
	  An el_clock over k_uptime_ticks(), in the kernel's ticks. Available
	  in a Zephyr build, which is how Elemental reaches a microcontroller.
```

## tests/zephyr/boards/st/nucleo_g0b1re_renode/nucleo_g0b1re_renode_defconfig
```kconfig
# SPDX-FileCopyrightText: Copyright The Zephyr Project Contributors
# Copied unchanged from boards/st/nucleo_g0b1re/nucleo_g0b1re_defconfig at
# Zephyr v4.5.0.
# SPDX-License-Identifier: Apache-2.0

# Enable MPU
CONFIG_ARM_MPU=y

# Serial Drivers
CONFIG_SERIAL=y
CONFIG_UART_INTERRUPT_DRIVEN=y
# enable console
CONFIG_CONSOLE=y
CONFIG_UART_CONSOLE=y
```
